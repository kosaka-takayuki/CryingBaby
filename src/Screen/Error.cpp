#include "Screen/Error.h"

////////////////////////////////////////////////////////////////////////////////////////////////////////////////////////////
// Error
////////////////////////////////////////////////////////////////////////////////////////////////////////////////////////////
void Error(){	//

//Serial.print("#D");
	int _DrawY =0;
	boolean isDraw = false;	//更新する必要があるかどうか


	String DrawMSG ="";


	
	int _AnimationTime =100;


	/////////////////////////////////////////////////////////////////////////////////////
    //画面設定
	/////////////////////////////////////////////////////////////////////////////////////

	/////////////////////////////////////////////////////////////////////////////////////
    // 時間経過アニメーション　徐々にフェードイン
	/////////////////////////////////////////////////////////////////////////////////////

	

	//最初の一度だけ実行
	if( Device.isModeChangeFirstTime == false ){
		DrawTitle("Device Error", 600, TASK_Status_Run );
		Device.AquesTalk.playK("デバイスエラー /接続機器を確認してください", 50, Device.isAquesTalk);                          //AquesTalkで会話　会話スピードは最低の50

		
		Device.isModeChangeFirstTime = true;

		Device.Button[ Button_SystemCheck	].SetSelectButton(0);
		Device.Button[ Button_SystemCheck ].SelectButton_OLD =0;	

		Device.Button[Button_SystemCheck	    ].isClick = false;
		Device.Button[Button_SystemCheck	    ].ClickPoint_B.x =-1;
		Device.Button[Button_SystemCheck	    ].ClickPoint_B.y =-1;


			///////////////////////////////////////////////////////////////////////////////
			// 問題があるとき
			///////////////////////////////////////////////////////////////////////////////
			Device.isCheck.isDeviceClear = false;
			OutPutLogs(LogCode_Info, 3,"+-- Total Error Check: error --");    //Log出力
			SetTapeLEDs(64 , 0,0,255); //LEDセット 


			_DrawY = 40;
			if(Device.isCheck.isDFPlayer       == false){
				//////////////////////////////////////////////////////////////////////////////
				//DFPlayer
				///////////////////////////////////////////////////////////////////////////////
				DrawBox("DFPlayer",_DrawY,_AnimationTime);	//アニメーション付きBOX描写

				///////////////////////////////////////////////////////////////////////////////
				// 接続チェック
				///////////////////////////////////////////////////////////////////////////////
				if (Device.isMp3DeviceCheckStatus == 0 && MP3.error_code == 0) {
					//失敗
					DrawBoxResult("not stuck", _DrawY, _AnimationTime, false);
				} else if (Device.isMp3DeviceCheckStatus == 0 &&  MP3.error_code == 129) {
					//失敗
					DrawBoxResult("not found", _DrawY, _AnimationTime, false);
				}
			}else{

			}

			if(Device.isCheck.isSDCard == false){
				///////////////////////////////////////////////////////////////////////////////
				//SD CARD
				///////////////////////////////////////////////////////////////////////////////
						_DrawY +=22;
						DrawBox("SD Card",_DrawY,_AnimationTime);	//アニメーション付きBOX描写
						DrawBoxResult("Not Stuck", _DrawY, _AnimationTime, false);
			}

			if(Device.isCheck.isFile_Threshold == false){
				///////////////////////////////////////////////////////////////////////////////
				//LoadThreshold File
				///////////////////////////////////////////////////////////////////////////////
				_DrawY +=22;
				DrawBox("Threshold File",_DrawY,_AnimationTime);	//アニメーション付きBOX描写
				DrawBoxResult("Failure", _DrawY, _AnimationTime, false);
			}
			

			if(Device.isCheck.isFile_Interval == false){
				///////////////////////////////////////////////////////////////////////////////
				//Interval_File
				///////////////////////////////////////////////////////////////////////////////
				_DrawY +=22;
				DrawBox("Interval File",_DrawY,_AnimationTime);	//アニメーション付きBOX描写
				DrawBoxResult("Failure", _DrawY, _AnimationTime, false);
			}

			if(Device.isCheck.isIMU == false){
				///////////////////////////////////////////////////////////////////////////////
				//IMU
				///////////////////////////////////////////////////////////////////////////////
					_DrawY +=22;
					DrawBox("IMU",_DrawY,_AnimationTime);	//アニメーション付きBOX描写
					DrawBoxResult("failure", _DrawY, _AnimationTime, false);
			}



	}


	/////////////////////////////////////////////////////////////////////
	//FPS表示
	/////////////////////////////////////////////////////////////////////
	isDraw =DrawFPS(BaseColor_Tomato);


	
////////////////////////////////////////////////
	//フリックボタンの描写
	////////////////////////////////////////////////
	if( Device.Button[ Button_SystemCheck ].DrawButton( Button_SystemCheck, 190 )  == true){	isDraw =true;	DrawMSG +="Button \t";}

	////////////////////////////////////////////////////
	// 更新する
	////////////////////////////////////////////////////
	if(isDraw == true){
		if(DrawMSG !=""){
//			Serial.println(DrawMSG);
		}
		Device.LCD.startWrite();
			Device.LCD_Sprite.pushSprite(&Device.LCD,10,10);
		Device.LCD.endWrite();	

	}



}