
#include "Device/MotorPump.h"

// #include "Gloabal/Variable.h"
	////////////////////////////////////////////////////////////////////////////////////////////////////////////////////////////
	// コンストラクタ
	////////////////////////////////////////////////////////////////////////////////////////////////////////////////////////////
		MotorPump::MotorPump(){

		}
	////////////////////////////////////////////////////////////////////////////////////////////////////////////////////////////
	// コンストラクタ
	////////////////////////////////////////////////////////////////////////////////////////////////////////////////////////////
		void MotorPump::Initialize(String _name, byte _adress ){
			this->Name = _name;
			this->Adress = _adress;
		}

	////////////////////////////////////////////////////////////////////////////////////////////////////////////////////////////
	// SetStatus
	////////////////////////////////////////////////////////////////////////////////////////////////////////////////////////////
		void MotorPump::SetSpeed(int _Speed) { //pwr -255 to 255
			this->Speed = _Speed;	//スピード設定
		}


	////////////////////////////////////////////////////////////////////////////////////////////////////////////////////////////
	// RUN
	////////////////////////////////////////////////////////////////////////////////////////////////////////////////////////////
		void MotorPump::Run(bool _isUSB) { //pwr -255 to 255

				/////////////////////////////////////////////////////////////////////////
				// バッテリー駆動時に、モータを動作させておくと、電力が足りずに再起動がかかるので
				// バッテリー駆動時は、モータを停止させる
				/////////////////////////////////////////////////////////////////////////
				if(_isUSB == false && this->isBatteryStop == false){	//バッテリー駆動の時のみ
					this->Speed =  Motor_STOP;	//スピード設定
					this->isBatteryStop = true;	//バッテリー停止フラグ
				}
				////////////////////////////////////////////////////////////////////////
				//再開設定 USB接続時は再開させる
				////////////////////////////////////////////////////////////////////////
				if(_isUSB == true && this->isBatteryStop == true){
					this->Speed = this->Speed_Old;	//スピード設定
					this->isBatteryStop = false;
				}

				if(this->Speed != this->Speed_Old){

//Serial.println("MOTOR ---------------------------- ");

					////////////////////////////////////////
					//モータ制御の時
					////////////////////////////////////////
					byte dir, st;
					if (this->Speed < 0) dir = 2;
					else dir =1;
					byte ipower=(byte) (abs(this->Speed )/4);
					if (ipower == 0) dir=3; //brake
					ipower = constrain (ipower, 0, 63);
					st = MotoroRead(  );
					if (st & 1) MotorWrite( 0, 0);
					MotorWrite( ipower, dir);
					delay(10);

					this->Speed_Old = this->Speed;
				}

/*
					//スピード値が変わったら実行する
					if( this->Speed != this->Speed_Old){
							////////////////////////////////////////
							//モータ制御の時
							////////////////////////////////////////
							byte dir, st;
							if (this->Speed < 0) dir = 2;
							else dir =1;
							byte ipower=(byte) (abs(this->Speed )/4);
							if (ipower == 0) dir=3; //brake

							ipower = constrain (ipower, 0, 63);
							st = MotoroRead(  );
							if (st & 1) MotorWrite( 0, 0);
							MotorWrite( ipower, dir);

							this->Speed_Old = this->Speed;
							delay(10);
					}
*/

		}
	////////////////////////////////////////////////////////////////////////////////////////////////////////////////////////////
	// RUN
	////////////////////////////////////////////////////////////////////////////////////////////////////////////////////////////
/*
		void MotorPump::Run(PCA9554 &exp ) { //pwr -255 to 255

				if( this->Speed != this->Speed_Old){
						////////////////////////////////////////
						//バルブ制御の時
						////////////////////////////////////////

						switch (this->Adress){
						case 100:
							exp.digitalWrite0(0, this->Speed);	//出力		Button_Motor_ValveA_OFF
							break;
						case 101:
							exp.digitalWrite0(1, this->Speed);	//出力		Button_Motor_ValveA_OFF
							break;
						
						}


						this->Speed_Old = this->Speed;
				}
		}
*/

	////////////////////////////////////////////////////////////////////////////////////////////////////////////////////////////
	// MotorWrite
	////////////////////////////////////////////////////////////////////////////////////////////////////////////////////////////
		void MotorPump:: MotorWrite(byte pwm, byte ctrl) {
			Wire1.beginTransmission(this->Adress);
			Wire1.write(0);
			Wire1.write(pwm*4+ctrl);
			Wire1.endTransmission(true);
		}

	////////////////////////////////////////////////////////////////////////////////////////////////////////////////////////////
	// MotoRead
	////////////////////////////////////////////////////////////////////////////////////////////////////////////////////////////
		int MotorPump::MotoroRead() {
			Wire1.beginTransmission(this->Adress);
			Wire1.write(1);
			Wire1.endTransmission(false);
			Wire1.requestFrom((int)this->Adress, (int)1, (int)1);
			return Wire1.read();
		}

